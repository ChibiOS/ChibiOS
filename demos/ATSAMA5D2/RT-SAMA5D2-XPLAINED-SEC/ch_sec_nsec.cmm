; --------------------------------------------------------------------------------
; @Title: SEC/NSEC demo script for ATSAMA5D28 on ATSAMA5D2B-XULT
; @Description:
;   Test the TSSI api, the socket proxy and the Trusted Execution Environment
; @Keywords: ARM, Cortex-A5
; @Author: Orabona
; @Board: ATSAMA5D2B-XULT
; @Chip: ATSAMA5D28
; --------------------------------------------------------------------------------


; --------------------------------------------------------------------------------
; initialize and start the debugger
RESet
SYStem.RESet
SYStem.Config SWDP ON
SYStem.CPU ATSAMA5D28
IF VERSION.BUILD()<84227.
(
  SYStem.CONFIG L2CACHE Type L2C-310
  SYStem.CONFIG L2CACHE Base ANC:0xA00000
)
SYStem.Option ResBreak OFF
SYStem.Option EnReset OFF
SYStem.Option WaitReset 30.ms
SYStem.Option ZoneSPACES ON
SYStem.JtagClock CTCK 10MHz
Trace.DISable
SYStem.Up

GOSUB DisableWatchdog

; --------------------------------------------------------------------------------
; load demo program (uses internal RAM only)
;Data.LOAD.Elf "~/bootstrap_bv1000.elf" Z:
Data.LOAD.Elf "~/bootstrap.elf" Z:
Register.Set PC 0x200000
Go
PRINT "Wait!"
WAIT !STATE.RUN()

Data.LOAD.Elf "~/Chibilogic/GBC/ChibiOS/demos/ATSAMA5D2/RT-SAMA5D2-XPLAINED-NSEC/build/ch.elf" N:

Data.LOAD.Elf "~/Chibilogic/GBC/ChibiOS/demos/ATSAMA5D2/RT-SAMA5D2-XPLAINED-SEC/build/ch.elf" Z: /NAME ch_sec /NoClear

; --------------------------------------------------------------------------------
; start program execution
Register.Set PC 0x27000000
Go Boot_Handler
WAIT !STATE.RUN()

b.s main

ENDDO

DisableWatchdog:
(
  ; disable the Watchdog
  Data.Set AD:0xF8048044 %Long Data.Long(AD:0xF8048044)|0x8000
  RETURN
)
